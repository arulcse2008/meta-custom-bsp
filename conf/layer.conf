## conf/layer.conf
```bitbake
# ---------------------------------------------------------------------------------------------------------------------
# meta-custom-bsp layer for Industrial OS
# ---------------------------------------------------------------------------------------------------------------------
# This material contains trade secrets or otherwise confidential information owned by Siemens AG
# or its licensors. Access to and use of this information is strictly limited
# as set forth in the Customer's applicable agreements with SISW.
# ---------------------------------------------------------------------------------------------------------------------
# Unpublished work. Copyright 2024 Siemens
# ---------------------------------------------------------------------------------------------------------------------

# We have a conf and classes directory, add to BBPATH
BBPATH .= ":${LAYERDIR}"

# We have recipes-* directories, add to BBFILES
BBFILES +=  "${LAYERDIR}/recipes-*/*/*.bb       \
             ${LAYERDIR}/recipes-*/*/*.bbappend \
"

BBFILE_COLLECTIONS += "meta-custom-bsp"
BBFILE_PATTERN_meta-custom-bsp = "^${LAYERDIR}/recipes-"
BBFILE_PRIORITY_meta-custom-bsp = "31"
LAYERDEPENDS_meta-custom-bsp = "meta-apollon"
LAYERSERIES_COMPAT_meta-custom-bsp = "${LAYERSERIES_COMPAT_meta-apollon}"

LAYERDIR_meta-custom-bsp = "${LAYERDIR}"

# This should only be incremented on significant changes that will
# cause compatibility issues with other layers
LAYERVERSION_meta-custom-bsp = "1"
```
